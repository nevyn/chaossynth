// Chaossynth panel firmware: scans buttons and pots, emits USB MIDI exactly as
// docs/midi-contract.md specifies. Target: Waveshare RP2350-Zero, arduino-pico
// core, Adafruit TinyUSB stack.
//
// Build + flash: ../build.sh [--flash]  (pins the core and libraries; see README.md)
// Equivalent Arduino IDE setup:
//   Boards Manager: "Raspberry Pi Pico/RP2040/RP2350" by Earle F. Philhower III (5.6.1)
//   Tools > Board: Waveshare RP2350 Zero;  Tools > USB Stack: Adafruit TinyUSB
//   Libraries: Adafruit TinyUSB Library 3.7.7, MIDI Library 5.0.2,
//              Adafruit MCP23017 Arduino Library 2.3.2

#include <Arduino.h>
#include <Wire.h>
#include <Adafruit_MCP23X17.h>
#include <Adafruit_TinyUSB.h>
#include <MIDI.h>

#include "pot_filter.h"

////////////// USB MIDI //////////////

Adafruit_USBD_MIDI usbMidiTransport;
MIDI_CREATE_INSTANCE(Adafruit_USBD_MIDI, usbMidiTransport, MIDI);

////////////// Control types //////////////
//
// The control tables live in mapping.h, generated by layout-tool from
// synth/mapping.json. These types define the table shapes; the constexpr
// factories keep the generated tables readable as a menu of where each
// control lives and what it emits.

enum ButtonType : uint8_t {
  BTN_NOTE,          // NoteOn(midi,127) / NoteOff(midi,0) — the contract default
  BTN_CC_MOMENTARY,  // CC(midi,127) on press, CC(midi,0) on release
  BTN_CC_TOGGLE,     // CC(midi,127) / CC(midi,0) alternating per press
};

struct Button {
  uint8_t expanderIdx;  // 0xFF means direct Pico GPIO; otherwise index into expanderAddresses[]
  uint8_t pin;          // direct: Pico GPIO number; expander: 0..15 (GPA0..GPB7)
  uint8_t midi;         // note number, or CC number for the BTN_CC_* types
  ButtonType type;

  static constexpr Button onPico(uint8_t gpio, uint8_t midi, ButtonType type = BTN_NOTE) {
    return Button{ 0xFF, gpio, midi, type };
  }
  static constexpr Button onExpander(uint8_t expIdx, uint8_t pin, uint8_t midi,
                                     ButtonType type = BTN_NOTE) {
    return Button{ expIdx, pin, midi, type };
  }

  bool isDirect() const { return expanderIdx == 0xFF; }
};

struct Pot {
  uint8_t muxIdx;  // 0xFF means direct Pico ADC; otherwise index into muxes[]
  uint8_t pin;     // direct: ADC-capable Pico GPIO (26-29); mux: channel 0..7
  uint8_t cc;      // MIDI CC number

  static constexpr Pot onPico(uint8_t adcGpio, uint8_t cc) {
    return Pot{ 0xFF, adcGpio, cc };
  }
  static constexpr Pot onMux(uint8_t muxIdx, uint8_t channel, uint8_t cc) {
    return Pot{ muxIdx, channel, cc };
  }

  bool isDirect() const { return muxIdx == 0xFF; }
};

struct Mux {
  // TMUX4051 (or any 8:1 analog mux with 3 select lines). Multiple muxes can share
  // select pins to save GPIOs; each still needs its own ADC pin on the Pico.
  uint8_t s0;
  uint8_t s1;
  uint8_t s2;
  uint8_t adcPin;  // ADC-capable Pico GPIO (26-29)
};

////////////// Engine tuning //////////////

constexpr uint8_t  MIDI_CHANNEL      = 1;
constexpr uint32_t I2C_CLOCK_HZ      = 400000;
constexpr uint16_t POLL_INTERVAL_MS  = 5;
constexpr uint16_t MUX_SETTLE_US     = 5;
constexpr uint16_t DEBOUNCE_MS       = 10;
constexpr uint16_t EXPANDER_CHECK_MS = 250;
constexpr bool     SERIAL_DEBUG      = true;

#include "mapping.h"

////////////// State //////////////

constexpr size_t NUM_EXPANDERS = sizeof(expanderAddresses) / sizeof(expanderAddresses[0]);
constexpr size_t NUM_MUXES     = sizeof(muxes) / sizeof(muxes[0]);
constexpr size_t NUM_BUTTONS   = sizeof(buttons) / sizeof(buttons[0]);
constexpr size_t NUM_POTS      = sizeof(pots) / sizeof(pots[0]);

Adafruit_MCP23X17 expanders[NUM_EXPANDERS > 0 ? NUM_EXPANDERS : 1];
bool      expanderOk[NUM_EXPANDERS > 0 ? NUM_EXPANDERS : 1]  = { false };
bool      buttonState[NUM_BUTTONS > 0 ? NUM_BUTTONS : 1]     = { false };
bool      toggleState[NUM_BUTTONS > 0 ? NUM_BUTTONS : 1]     = { false };
uint32_t  lastEdgeMs[NUM_BUTTONS > 0 ? NUM_BUTTONS : 1]      = { 0 };
PotFilter potFilters[NUM_POTS > 0 ? NUM_POTS : 1];

////////////// Expanders //////////////
//
// Festival reality: a loose I2C wire or a brownout-reset MCP23017 must self-heal,
// loudly. Every EXPANDER_CHECK_MS we probe each chip; a chip that (re)appears is
// reconfigured, and healthy chips get their pullup config re-asserted because a
// brownout-reset chip still ACKs but has lost it (floating inputs = random notes).

// MCP23017 registers, BANK=0 (the power-on default the Adafruit lib also uses).
constexpr uint8_t MCP_GPPUA = 0x0C;
constexpr uint8_t MCP_GPPUB = 0x0D;

static void writeExpanderReg(uint8_t addr, uint8_t reg, uint8_t val) {
  Wire.beginTransmission(addr);
  Wire.write(reg);
  Wire.write(val);
  Wire.endTransmission();
}

static bool configureExpander(size_t i) {
  // begin_I2C leaks a small allocation per call (Adafruit lib), so it is only
  // called on a not-ok -> ok transition, never in a retry loop.
  if (!expanders[i].begin_I2C(expanderAddresses[i], &Wire)) return false;
  for (uint8_t p = 0; p < 16; p++) {
    expanders[i].pinMode(p, INPUT_PULLUP);
  }
  return true;
}

static void maintainExpanders(uint32_t now) {
  static uint32_t lastCheck = 0;
  static bool ranOnce = false;
  if (ranOnce && now - lastCheck < EXPANDER_CHECK_MS) return;
  ranOnce = true;
  lastCheck = now;

  for (size_t i = 0; i < NUM_EXPANDERS; i++) {
    Wire.beginTransmission(expanderAddresses[i]);
    bool present = Wire.endTransmission() == 0;
    if (present && !expanderOk[i]) {
      expanderOk[i] = configureExpander(i);
      if (SERIAL_DEBUG && expanderOk[i]) {
        Serial.print("expander "); Serial.print(i); Serial.println(" up");
      }
    } else if (!present && expanderOk[i]) {
      expanderOk[i] = false;
      if (SERIAL_DEBUG) {
        Serial.print("expander "); Serial.print(i); Serial.println(" LOST");
      }
    } else if (present && expanderOk[i]) {
      writeExpanderReg(expanderAddresses[i], MCP_GPPUA, 0xFF);
      writeExpanderReg(expanderAddresses[i], MCP_GPPUB, 0xFF);
    }
  }
}

////////////// Scanning //////////////

static void selectMuxChannel(const Mux& m, uint8_t channel) {
  digitalWrite(m.s0,  channel       & 0x01);
  digitalWrite(m.s1, (channel >> 1) & 0x01);
  digitalWrite(m.s2, (channel >> 2) & 0x01);
  delayMicroseconds(MUX_SETTLE_US);
}

static void scanButtons(uint32_t now) {
  // Batch-read every healthy expander once per poll (single I2C transaction per
  // chip). A lost expander reads as all-released, so its held notes get NoteOffs
  // through the normal transition path instead of sticking for a week.
  uint16_t expanderBits[NUM_EXPANDERS > 0 ? NUM_EXPANDERS : 1];
  for (size_t i = 0; i < NUM_EXPANDERS; i++) {
    expanderBits[i] = expanderOk[i] ? expanders[i].readGPIOAB() : 0xFFFF;
  }

  for (size_t i = 0; i < NUM_BUTTONS; i++) {
    const Button& b = buttons[i];
    bool pressed;
    if (b.isDirect()) {
      pressed = digitalRead(b.pin) == LOW;  // INPUT_PULLUP -> active-low
    } else {
      pressed = !((expanderBits[b.expanderIdx] >> b.pin) & 1);
    }
    if (pressed == buttonState[i]) continue;
    // Debounce: ignore any transition within DEBOUNCE_MS of the last accepted one.
    if (now - lastEdgeMs[i] < DEBOUNCE_MS) continue;
    lastEdgeMs[i] = now;
    buttonState[i] = pressed;

    switch (b.type) {
      case BTN_NOTE:
        if (pressed) MIDI.sendNoteOn(b.midi, 127, MIDI_CHANNEL);
        else         MIDI.sendNoteOff(b.midi, 0, MIDI_CHANNEL);
        break;
      case BTN_CC_MOMENTARY:
        MIDI.sendControlChange(b.midi, pressed ? 127 : 0, MIDI_CHANNEL);
        break;
      case BTN_CC_TOGGLE:
        if (pressed) {
          toggleState[i] = !toggleState[i];
          MIDI.sendControlChange(b.midi, toggleState[i] ? 127 : 0, MIDI_CHANNEL);
        }
        break;
    }
    if (SERIAL_DEBUG) {
      Serial.print("button "); Serial.print(i); Serial.println(pressed ? " down" : " up");
    }
  }
}

static void scanPots() {
  for (size_t i = 0; i < NUM_POTS; i++) {
    const Pot& p = pots[i];
    uint16_t raw;
    if (p.isDirect()) {
      raw = analogRead(p.pin);
    } else {
      const Mux& m = muxes[p.muxIdx];
      selectMuxChannel(m, p.pin);
      raw = analogRead(m.adcPin);
    }
    int value7 = potFilters[i].update(raw);
    if (value7 >= 0) {
      MIDI.sendControlChange(p.cc, value7, MIDI_CHANNEL);
      if (SERIAL_DEBUG) {
        Serial.print("pot "); Serial.print(i); Serial.print(" -> "); Serial.println(value7);
      }
    }
  }
}

////////////// Startup //////////////

void setup() {
  if (SERIAL_DEBUG) {
    Serial.begin(115200);
  }

  usbMidiTransport.setStringDescriptor("Chaossynth");
  MIDI.begin(MIDI_CHANNEL_OMNI);
  // The MIDI library enables soft-thru by default; combined with MIDI.read()
  // that would echo anything the host sends back out — bytes the contract
  // doesn't allow us to emit.
  MIDI.turnThruOff();

  Wire.setSDA(I2C_SDA_PIN);
  Wire.setSCL(I2C_SCL_PIN);
  Wire.begin();
  Wire.setClock(I2C_CLOCK_HZ);

  for (size_t i = 0; i < NUM_MUXES; i++) {
    pinMode(muxes[i].s0, OUTPUT);
    pinMode(muxes[i].s1, OUTPUT);
    pinMode(muxes[i].s2, OUTPUT);
  }

  for (size_t i = 0; i < NUM_BUTTONS; i++) {
    if (buttons[i].isDirect()) {
      pinMode(buttons[i].pin, INPUT_PULLUP);
    }
  }

  analogReadResolution(12);
  // Expanders are brought up by maintainExpanders() on the first loop pass, so
  // a chip that is missing at boot but appears later still gets configured.
}

////////////// Main loop //////////////

void loop() {
  MIDI.read();  // drain and ignore any input; keeps the RX buffer from clogging

  // Nothing to say until the host has enumerated us — TinyUSB drops writes anyway.
  static bool wasMounted = false;
  if (!TinyUSBDevice.mounted()) {
    wasMounted = false;
    return;
  }
  if (!wasMounted) {
    wasMounted = true;
    // Contract: CC 123 (All Notes Off, value 0) once at boot. Also re-sent after
    // a cable yank, because the synth may still hold voices from before it.
    MIDI.sendControlChange(123, 0, MIDI_CHANNEL);
    if (SERIAL_DEBUG) Serial.println("USB mounted, sent CC 123");
  }

  static uint32_t lastPoll = 0;
  uint32_t now = millis();
  if (now - lastPoll < POLL_INTERVAL_MS) return;
  lastPoll = now;

  maintainExpanders(now);
  scanButtons(now);
  scanPots();
}
